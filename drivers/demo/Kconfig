## drivers/demo/Kconfig
```kconfig
# Copyright (c) 2024 Nordic Semiconductor ASA
# SPDX-License-Identifier: Apache-2.0

menuconfig DEMO
	bool "Demo device drivers"
	help
	  Enables the demo custom driver class.
	  This class is used for course demonstrations — every API call
	  produces a log message so the call chain is fully visible.

if DEMO

config DEMO_INIT_PRIORITY
	int "Demo device drivers init priority"
	default KERNEL_INIT_PRIORITY_DEVICE
	help
	  Initialisation priority for demo device instances.
	  Lower numbers initialise earlier.

module = DEMO
module-str = demo
source "subsys/logging/Kconfig.template.log_config"

rsource "Kconfig.demo_device"

endif # DEMO
```

## drivers/demo/Kconfig.demo_device
```kconfig
# Copyright (c) 2024 Nordic Semiconductor ASA
# SPDX-License-Identifier: Apache-2.0

config DEMO_DEVICE
	bool "Virtual demo device driver"
	default y
	depends on DT_HAS_DEMO_DEVICE_ENABLED
	help
	  Enable the virtual demo device driver.

	  This driver has no real hardware — every call to demo_enable(),
	  demo_disable(), or demo_get_status() emits a log message and
	  updates internal state. It is designed to demonstrate how custom
	  Zephyr driver classes work.

	  The driver is enabled automatically when a DT node with
	  compatible = "demo-device" and status = "okay" is present.
```

## dts/bindings/demo/demo-device.yaml
```yaml
# Copyright (c) 2024 Nordic Semiconductor ASA
# SPDX-License-Identifier: Apache-2.0

description: |
  A virtual demo device with no real hardware backing.
  Used to demonstrate how to build a custom Zephyr driver class
  with enable/disable/get_status API and Zephyr logging.

  Example definition in devicetree:

    demo_dev: demo-device {
        compatible = "demo-device";
        label = "MY_DEMO";
    };

compatible: "demo-device"

include: base.yaml

properties:
  label:
    type: string
    description: |
      Human-readable name for this demo device instance.
      Used in log messages so you can distinguish multiple instances.
  numeric_id:
    type: int
    description: |
      An optional numeric ID for this demo device instance.
      Used in log messages so you can distinguish multiple instances.
```
